# M460 register map
File version: 1.0
M460 SVD file
Registers are 32-bit, read-write, reset 0x0 unless marked. A register's access mark holds for its fields unless they carry their own. Offsets are from the block's base; lines under a group give offsets from that group; [hi:lo] are bit positions; {n}, {i} and the like mark numbered series; 'fields as' and 'values as' point back to an identical list; <NAME> marks a mode.

## Memory map
0x40000000 SYS blocks up to offset 0x5A0 — SYS Register Map
0x40000200 CLK blocks up to offset 0xB4 — CLK Register Map
0x40000300 NMI size 0x8 — NMI Register Map
0x40004000 GPIOA blocks up to offset 0x38 — GPIO Register Map
0x40004040 GPIOB blocks up to offset 0x38 — GPIO Register Map
0x40004080 GPIOC blocks up to offset 0x38 — GPIO Register Map
0x400040C0 GPIOD blocks up to offset 0x38 — GPIO Register Map
0x40004100 GPIOE blocks up to offset 0x38 — GPIO Register Map
0x40004140 GPIOF blocks up to offset 0x38 — GPIO Register Map
0x40004180 GPIOG blocks up to offset 0x38 — GPIO Register Map
0x400041C0 GPIOH blocks up to offset 0x38 — GPIO Register Map
0x40004200 GPIOI blocks up to offset 0x38 — GPIO Register Map
0x40004240 GPIOJ blocks up to offset 0x38 — GPIO Register Map
0x40004450 GPIOINT blocks up to offset 0x50 — GPIO Register Map
0x40004800 PA size 0x40 — GPIO Register Map
0x40004840 PB size 0x40 — GPIO Register Map
0x40004880 PC size 0x3C — GPIO Register Map
0x400048C0 PD size 0x3C — GPIO Register Map
0x40004900 PE size 0x40 — GPIO Register Map
0x40004940 PF size 0x30 — GPIO Register Map
0x40004980 PG size 0x40 — GPIO Register Map
0x400049C0 PH size 0x40 — GPIO Register Map
0x40004A00 PI blocks up to offset 0x40 — GPIO Register Map
0x40004A40 PJ size 0x38 — GPIO Register Map
0x40007000 SPIM blocks up to offset 0x4C — SPIM Register Map
0x40008000 PDMA0 blocks up to offset 0x610 — PDMA Register Map
0x40009000 USBH blocks up to offset 0x208 — USBH Register Map
0x4000C000 FMC blocks up to offset 0x114 — FMC Register Map
0x4000D000 SDH0 blocks up to offset 0x840 — SDH Register Map
0x4000E000 SDH1 blocks up to offset 0x840 — SDH Register Map
0x40010000 EBI blocks up to offset 0x28 — EBI Register Map
0x40012000 EMAC0 blocks up to offset 0x105C — EMAC Register Map
0x40018000 PDMA1 blocks up to offset 0x610 — PDMA Register Map
0x40019000 HSUSBD blocks up to offset 0x708 — USBD Register Map
0x4001A000 HSUSBH blocks up to offset 0xCC — USBH Register Map
0x40020000 CANFD0 blocks up to offset 0xFC — CANFD Register Map
0x40024000 CANFD1 blocks up to offset 0xFC — CANFD Register Map
0x40028000 CANFD2 blocks up to offset 0xFC — CANFD Register Map
0x4002C000 CANFD3 blocks up to offset 0xFC — CANFD Register Map
0x40030000 CCAP blocks up to offset 0x64 — CCAP Register Map
0x40031000 CRC size 0x14 — CRC Register Map
0x40032000 CRYPTO size 0x8 — CRYPTO Register Map
0x40032008 PRNG blocks up to offset 0xF00 — CRYPTO Register Map
0x40032050 AES blocks up to offset 0xEC4 — CRYPTO Register Map
0x40032300 HMAC blocks up to offset 0xC34 — CRYPTO Register Map
0x40032800 ECC blocks up to offset 0x74C — CRYPTO Register Map
0x40032B00 RSA blocks up to offset 0x45C — CRYPTO Register Map
0x40035000 KS blocks up to offset 0x48 — KS Register Map
0x40040000 WDT size 0xC — WDT Register Map
0x40040100 WWDT size 0x10 — WWDT Register Map
0x40041000 RTC blocks up to offset 0x138 — RTC Register Map
0x40043000 EADC0 blocks up to offset 0xFFC — EADC Register Map
0x40045000 ACMP01 size 0x18 — ACMP Register Map
0x40047000 DAC blocks up to offset 0x58 — DAC Register Map
0x40048000 I2S0 blocks up to offset 0x28 — I2S Register Map
0x40049000 I2S1 blocks up to offset 0x28 — I2S Register Map
0x4004B000 EADC1 blocks up to offset 0xFFC — EADC Register Map
0x4004D000 OTG size 0x14 — OTG Register Map
0x4004F000 HSOTG size 0x14 — HSOTG Register Map
0x40050000 TMR01 blocks up to offset 0x1BC — TIMER Register Map
0x40051000 TMR23 blocks up to offset 0x1BC — TIMER Register Map
0x40058000 EPWM0 blocks up to offset 0x380 — EPWM Register Map
0x40059000 EPWM1 blocks up to offset 0x380 — EPWM Register Map
0x4005A000 BPWM0 blocks up to offset 0x334 — BPWM Register Map
0x4005B000 BPWM1 blocks up to offset 0x334 — BPWM Register Map
0x40060000 QSPI0 blocks up to offset 0x34 — QSPI Register Map
0x40061000 SPI0 blocks up to offset 0x6C — SPI Register Map
0x40062000 SPI1 blocks up to offset 0x6C — SPI Register Map
0x40063000 SPI2 blocks up to offset 0x6C — SPI Register Map
0x40064000 SPI3 blocks up to offset 0x6C — SPI Register Map
0x40069000 QSPI1 blocks up to offset 0x34 — QSPI Register Map
0x40070000 UART0 size 0x50 — UART Register Map
0x40071000 UART1 size 0x50 — UART Register Map
{0x40070000+0x1000*n} UART{n} blocks up to offset 0x50 (n=2..9) — UART Register Map
0x40080000 I2C0 blocks up to offset 0x6C — I2C Register Map
0x40081000 I2C1 blocks up to offset 0x6C — I2C Register Map
0x40082000 I2C2 blocks up to offset 0x6C — I2C Register Map
0x40083000 I2C3 blocks up to offset 0x6C — I2C Register Map
0x40084000 I2C4 blocks up to offset 0x6C — I2C Register Map
0x40090000 SC0 blocks up to offset 0x50 — SC Register Map
0x40091000 SC1 blocks up to offset 0x50 — SC Register Map
0x40092000 SC2 blocks up to offset 0x50 — SC Register Map
0x40097000 EADC2 blocks up to offset 0xFFC — EADC Register Map
0x400B0000 EQEI0 blocks up to offset 0x30 — EQEI Register Map
0x400B1000 EQEI1 blocks up to offset 0x30 — EQEI Register Map
0x400B2000 EQEI2 blocks up to offset 0x30 — EQEI Register Map
0x400B3000 EQEI3 blocks up to offset 0x30 — EQEI Register Map
0x400B4000 ECAP0 size 0x20 — ECAP Register Map
0x400B5000 ECAP1 size 0x20 — ECAP Register Map
0x400B6000 ECAP2 size 0x20 — ECAP Register Map
0x400B7000 ECAP3 size 0x20 — ECAP Register Map
0x400B9000 TRNG blocks up to offset 0x10 — TRNG Register Map
0x400C0000 USBD blocks up to offset 0x690 — USBD Register Map
0x400C2000 KPI blocks up to offset 0x2C — KPI Register Map
0x400C3000 PSIO blocks up to offset 0x13C — PSIO Register Map
0x400C9000 ACMP23 size 0x18 — ACMP Register Map
0x400CE000 HBI size 0x1C — HBI Register Map
0x400D0000 UUART0 blocks up to offset 0x68 — USCIUART Register Map
0x400D0000 USPI0 blocks up to offset 0x68 — USCISPI Register Map
0x400D0000 UI2C0 blocks up to offset 0x90 — USCII2C Register Map
0xE000E000 SCS blocks up to offset 0xD24 — SYST_SCR Register Map
0xE000E100 NVIC blocks up to offset 0xE04 — NVIC Register Map
