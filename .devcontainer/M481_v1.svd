# M481_v1 register map
File version: 1.0
M481_v1 SVD file
Registers are 32-bit, read-write, reset 0x0 unless marked. A register's access mark holds for its fields unless they carry their own. Offsets are from the block's base; lines under a group give offsets from that group; [hi:lo] are bit positions; {n}, {i} and the like mark numbered series; 'fields as' and 'values as' point back to an identical list; <NAME> marks a mode.

## Memory map
0x40000000 SYS blocks up to offset 0x404 — SYS Register Map
0x40000200 CLK blocks up to offset 0xB4 — CLK Register Map
0x40000300 NMI size 0x8 — NMI Register Map
0x40000400 AHB size 0x4 — AHB Register Map
0x40004000 GPIO blocks up to offset 0x9F4 — GPIO Register Map
0x40007000 SPIM blocks up to offset 0x4C — SPIM Register Map
0x40008000 DSCT_CTL blocks up to offset 0xF4 — PDMA Register Map
0x40008000 PDMA blocks up to offset 0x610 — PDMA Register Map
0x40008004 DSCT_SA blocks up to offset 0xF4 — PDMA Register Map
0x40008008 DSCT_DA blocks up to offset 0xF4 — PDMA Register Map
0x4000800C DSCT_NEXT blocks up to offset 0xF4 — PDMA Register Map
0x40008100 CURSCAT size 0x40 — PDMA Register Map
0x40009000 USBH blocks up to offset 0x208 — USBH Register Map
0x4000B000 EMAC blocks up to offset 0x130 — EMAC Register Map
0x4000C000 FMC blocks up to offset 0xE4 — FMC Register Map
0x4000D000 SDH0 blocks up to offset 0x840 — SDH Register Map
0x4000E000 SDH1 blocks up to offset 0x840 — SDH Register Map
0x40010000 EBI blocks up to offset 0x28 — EBI Register Map
0x40019000 HSUSBD blocks up to offset 0x708 — USBD Register Map
0x4001A000 HSUSBH blocks up to offset 0xCC — USBH Register Map
0x40030000 CCAP blocks up to offset 0x64 — CCAP Register Map
0x40031000 CRC size 0x10 — CRC Register Map
0x40040000 WDT size 0xC — WDT Register Map
0x40040100 WWDT size 0x10 — WWDT Register Map
0x40041000 RTC blocks up to offset 0x138 — RTC Register Map
0x40043000 EADC0 blocks up to offset 0x134 — EADC Register Map
0x40045000 ACMP01 size 0x10 — ACMP Register Map
0x40046000 OPA size 0x10 — OPA Register Map
0x40047000 DAC blocks up to offset 0x58 — DAC Register Map
0x40048000 I2S blocks up to offset 0x28 — I2S Register Map
0x4004B000 EADC1 blocks up to offset 0x134 — EADC Register Map
0x4004D000 OTG size 0x14 — OTG Register Map
0x4004F000 HSOTG size 0x14 — HSOTG Register Map
0x40050000 TMR01 blocks up to offset 0x1A8 — TIMER Register Map
0x40051000 TMR23 blocks up to offset 0x1A8 — TIMER Register Map
0x40058000 EPWM0 blocks up to offset 0x350 — EPWM Register Map
0x40059000 EPWM1 blocks up to offset 0x350 — EPWM Register Map
0x4005A000 BPWM0 blocks up to offset 0x334 — BPWM Register Map
0x4005B000 BPWM1 blocks up to offset 0x334 — BPWM Register Map
0x40060000 QSPI0 blocks up to offset 0x34 — QSPI Register Map
0x40061000 SPI0 blocks up to offset 0x6C — SPI Register Map
0x40062000 SPI1 blocks up to offset 0x6C — SPI Register Map
0x40063000 SPI2 blocks up to offset 0x6C — SPI Register Map
0x40064000 SPI3 blocks up to offset 0x6C — SPI Register Map
0x40069000 QSPI1 blocks up to offset 0x34 — QSPI Register Map
0x40070000 UART0 size 0x4C — UART Register Map
0x40071000 UART1 size 0x4C — UART Register Map
0x40072000 UART2 blocks up to offset 0x4C — UART Register Map
0x40073000 UART3 blocks up to offset 0x4C — UART Register Map
0x40074000 UART4 blocks up to offset 0x4C — UART Register Map
0x40075000 UART5 blocks up to offset 0x4C — UART Register Map
0x40076000 UART6 blocks up to offset 0x4C — UART Register Map
0x40077000 UART7 blocks up to offset 0x4C — UART Register Map
0x40080000 I2C0 blocks up to offset 0x6C — I2C Register Map
0x40081000 I2C1 blocks up to offset 0x6C — I2C Register Map
0x40082000 I2C2 blocks up to offset 0x6C — I2C Register Map
0x40090000 SC0 blocks up to offset 0x50 — SC Register Map
0x40091000 SC1 blocks up to offset 0x50 — SC Register Map
0x40092000 SC2 blocks up to offset 0x50 — SC Register Map
0x400A0000 CAN0 blocks up to offset 0x170 — CAN Register Map
0x400A1000 CAN1 blocks up to offset 0x170 — CAN Register Map
0x400A2000 CAN2 blocks up to offset 0x170 — CAN Register Map
0x400B0000 QEI0 blocks up to offset 0x30 — QEI Register Map
0x400B1000 QEI1 blocks up to offset 0x30 — QEI Register Map
0x400B4000 ECAP0 size 0x20 — ECAP Register Map
0x400B5000 ECAP1 size 0x20 — ECAP Register Map
0x400B9000 TRNG blocks up to offset 0x10 — TRNG Register Map
0x400C0000 USBD blocks up to offset 0x5C0 — USBD Register Map
0x400D0000 UUART0 blocks up to offset 0x68 — UUARTUART Register Map
0x400D0000 USPI0 blocks up to offset 0x68 — USCISPI Register Map
0x400D0000 UI2C0 blocks up to offset 0x90 — UI2CI2C Register Map
0x400D1000 UUART1 blocks up to offset 0x68 — UUARTUART Register Map
0x400D1000 USPI1 blocks up to offset 0x68 — USCISPI Register Map
0x400D1000 UI2C1 blocks up to offset 0x90 — UI2CI2C Register Map
0x50080000 CRYPTO blocks up to offset 0xA58 — CRYPTO Register Map
0xE000E000 SCS blocks up to offset 0xD24 — SYST_SCR Register Map
0xE000E100 NVIC blocks up to offset 0xE04 — NVIC Register Map
