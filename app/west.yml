## app/west.yml
```yaml
#
# Copyright (c) 2023 iWorx Systems Inc.
#
# SPDX-License-Identifier: BSD-Protection
#

manifest:
  remotes:
    - name: antmicro
      url-base: https://github.com/antmicro
    - name: iworx_private
      url-base: git@github.com:iworx-systems
    - name: iworx_public
      url-base: https://github.com/iworx-systems

  projects:
    # Zephyr
    - name: zephyr
      remote: iworx_public
      revision: development
      import:
        path-prefix: zephyr_project
        name-allowlist:
          - hal_nuvoton
          - cmsis
          - segger
          - tinycrypt
          - mcuboot
          - nanopb

    # Cmock/Unity module
    - name: test
      remote: antmicro
      revision: main
      repo-path: zephyr-cmock-unity-module
      import: true

    # Boards
    - name: iworx-zephyr-boards
      remote: iworx_private
      path: iworx/boards
      repo-path: iworx-zephyr-boards.git
      revision: main

    # Drivers
    - name: iworx-zephyr-drivers
      path: iworx/drivers
      remote: iworx_private
      repo-path: iworx-zephyr-drivers.git
      revision: development

    # Acquisition
    - name: iworx-modules
      path: iworx/modules
      remote: iworx_systems_private
      repo-path: iworx-zephyr-modules.git
      revision: development

    # Protocol Buffers
    - name: iworx-proto
      path: iworx/protocol_buffers
      remote: iworx_systems_private
      repo-path: iworx-proto.git
      revision: main
    

  self:
    path: Zephyr-Dev-Container-Template
```
